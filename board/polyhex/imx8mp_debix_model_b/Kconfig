## board/polyhex/imx8mp_debix_model_b/Kconfig
```kconfig
if TARGET_IMX8MP_DEBIX_MODEL_B || TARGET_IMX8MP_DDR4_EVK

config SYS_BOARD
	default "imx8mp_debix_model_b"

config SYS_VENDOR
	default "polyhex"

config SYS_CONFIG_NAME
	default "imx8mp_debix_model_b"

config IMX_CONFIG
	default "board/polyhex/imx8mp_debix_model_b/imximage-8mp-lpddr4.cfg"

endif
```
